#include "display_anim.h"
#include "display_config.h"
#include "display.h"


// Diese Werte stammen aus dem Animator-Export:
#define FRAME_WIDTH  64
#define FRAME_HEIGHT 64

// Animation
const byte PROGMEM frames[][512] = {
  {0,0,0,0,0,0,0,0,0,0,0,0,0,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0,0},
  {0,0,0,0,0,0,0,0,0,0,0,0,0,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0,0},
  {0,0,0,0,0,0,0,0,0,0,0,0,0,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0,0},
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  {0,0,0,0,0,0,0,0,0,0,0,0,0,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0,0}
};

// Anzahl der Frames automatisch bestimmen
static const uint16_t FRAME_COUNT = sizeof(frames) / sizeof(frames[0]);

// ---------------- State-Machine für Idle-Animation ----------------------------

namespace {

enum IdleState {
    IDLE_OFF,
    IDLE_ANIM,
    IDLE_TEXT
};

IdleState     s_state          = IDLE_OFF;
uint16_t      s_frame          = 0;
unsigned long s_lastFrameTime  = 0;
unsigned long s_textStartTime  = 0;

// --- Textanimation ---
static const uint8_t MAX_IDLE_TEXT_LEN = 32;

char           s_textBuffer[MAX_IDLE_TEXT_LEN + 1] = {0};
uint8_t        s_textLen         = 0;
uint8_t        s_textCharIndex   = 0;
unsigned long  s_lastCharTime    = 0;

// --- Cursoranimation ---
bool           s_cursorVisible   = false;
unsigned long  s_lastCursorBlink = 0;

// --- Layout für Cursor (damit wir nur noch den Cursor zeichnen müssen) ---
bool           s_layoutReady     = false;
int16_t        s_textX           = 0;
int16_t        s_textY           = 0;
uint16_t       s_textW           = 0;
uint16_t       s_textH           = 0;

int16_t        s_cursorX         = 0;
int16_t        s_cursorY         = 0;
uint16_t       s_cursorW         = 0;
uint16_t       s_cursorH         = 0;

static int16_t s_cursorX1 = 0;   // x-offset aus getTextBounds
static int16_t s_cursorY1 = 0;   // y-offset aus getTextBounds

// ------------------------------------------------------------
// Frame-Cropping für 32px
// ------------------------------------------------------------

static void drawFrameCropped(DisplayType &display, uint16_t frameIdx) {
    // 1bpp Bitmap: bytes pro Zeile
    const int16_t bytesPerRow = (FRAME_WIDTH + 7) / 8;

    // Zielhöhe = min(FRAME_HEIGHT, SCREEN_HEIGHT)
    int16_t drawH = FRAME_HEIGHT;
    if (SCREEN_HEIGHT < FRAME_HEIGHT) drawH = SCREEN_HEIGHT;

    // Vertikal mittig aus dem 64px Frame ausschneiden
    int16_t srcYOffset = 0;
        if (drawH < FRAME_HEIGHT) {
        #if FRAME_CROP_MODE_CENTER
            srcYOffset = (FRAME_HEIGHT - drawH) / 2;
        #else
        srcYOffset = 0; // oben abschneiden
        #endif
}


    const uint8_t *bmp = (const uint8_t*)frames[frameIdx];
    bmp += srcYOffset * bytesPerRow;

    int16_t x = (SCREEN_WIDTH  - FRAME_WIDTH) / 2;
    int16_t y = (SCREEN_HEIGHT - drawH)      / 2;
    if (x < 0) x = 0;
    if (y < 0) y = 0;

    display.clearDisplay();
    display.drawBitmap(x, y, bmp, FRAME_WIDTH, drawH, DISPLAY_COLOR);
    display.display();
}


// ------------------------------------------------------------
// Animation zurücksetzen
// ------------------------------------------------------------
static void resetTextAnimation(unsigned long now) {
    const char *src = IDLE_TEXT_STRING;
    size_t len = strlen(src);
    if (len > MAX_IDLE_TEXT_LEN) len = MAX_IDLE_TEXT_LEN;

    memcpy(s_textBuffer, src, len);
    s_textBuffer[len] = '\0';

    s_textLen         = len;
    s_textCharIndex   = 0;
    s_lastCharTime    = 0;

    s_cursorVisible   = false;
    s_lastCursorBlink = 0;

    s_textStartTime   = now;

    s_layoutReady     = false;   // Layout wird später berechnet
}


// ------------------------------------------------------------
// Hilfsfunktion: Text zentriert zeichnen (für Tipp-Phase)
// (löscht weiterhin das Display – aber nur während des „Tippen“)
// ------------------------------------------------------------
static void drawIdleText(DisplayType &display, uint8_t count, bool showCursor) {
    if (count == 0) {
        display.clearDisplay();
        display.display();
        return;
    }

    if (count > s_textLen)
        count = s_textLen;

    char tmp[MAX_IDLE_TEXT_LEN + 2];

    memcpy(tmp, s_textBuffer, count);
    uint8_t len = count;

    if (showCursor && count == s_textLen) {
        tmp[len++] = '_';
    }

    tmp[len] = '\0';

    int16_t x1, y1;
    uint16_t w, h;

    display.clearDisplay();
    display.setTextWrap(false);
    display.setTextColor(DISPLAY_COLOR);

    display.getTextBounds(tmp, 0, 0, &x1, &y1, &w, &h);

    int16_t x = (SCREEN_WIDTH  - (int16_t)w) / 2 - x1;
    int16_t y = (SCREEN_HEIGHT - (int16_t)h) / 2 - y1;

    if (x < 0) x = 0;
    if (y < 0) y = 0;

    display.setCursor(x, y);
    display.print(tmp);
    display.display();
}


// ------------------------------------------------------------
// Layout für Text + Cursor berechnen (ohne irgendwas zu löschen)
// ------------------------------------------------------------
static void computeLayout(DisplayType &display) {
    if (s_layoutReady || s_textLen == 0) return;

    int16_t x1, y1;
    uint16_t wText, hText;


    // Nur den finalen Text vermessen
    display.getTextBounds(s_textBuffer, 0, 0, &x1, &y1, &wText, &hText);

    int16_t x = (SCREEN_WIDTH  - (int16_t)wText) / 2 - x1;
    int16_t y = (SCREEN_HEIGHT - (int16_t)hText) / 2 - y1;

    if (x < 0) x = 0;
    if (y < 0) y = 0;

    s_textX = x;
    s_textY = y;
    s_textW = wText;
    s_textH = hText;

    // Cursorbreite/-höhe bestimmen
    int16_t cx1, cy1;
    uint16_t cw, ch;
    display.getTextBounds("_", 0, 0, &cx1, &cy1, &cw, &ch);

    s_cursorX1 = cx1;
    s_cursorY1 = cy1;

    // Cursor zentriert auf neuer Zeile unter dem Text
    s_cursorX = (SCREEN_WIDTH - cw) / 2;
    s_cursorY = s_textY + s_textH + 4;   // +4 als Abstand nach unten

    // Clamp, damit Cursor immer im sichtbaren Bereich bleibt
    if (s_cursorY + (int16_t)ch > SCREEN_HEIGHT) {
        s_cursorY = SCREEN_HEIGHT - (int16_t)ch;
    }
    if (s_cursorY < 0) s_cursorY = 0;

    s_cursorW = cw;
    s_cursorH = ch;

    s_layoutReady = true;
}


// ------------------------------------------------------------
// Nur den Cursor zeichnen / löschen (kein clearDisplay!)
// ------------------------------------------------------------
static void drawCursor(DisplayType &display, bool visible) {
    if (!s_layoutReady) return;

    // Cursor-Bereich löschen
    display.fillRect(s_cursorX, s_cursorY, s_cursorW, s_cursorH, 0);

    if (visible) {
        display.setTextWrap(false);
        display.setTextColor(DISPLAY_COLOR);

        // ✅ Baseline-Korrektur (DAS war der Bug!)
        display.setCursor(
            s_cursorX - s_cursorX1,
            s_cursorY - s_cursorY1
        );
        display.print("_");
    }

    display.display();
}


} // Ende anonymer Namespace




// ============================================================
// PUBLIC API – NAMESPACE DisplayAnim
// ============================================================

namespace DisplayAnim {


// ------------------------------------------------------------
// Idle normal starten → Animation zuerst
// ------------------------------------------------------------
void startIdle(unsigned long now) {
    s_state         = IDLE_ANIM;
    s_frame         = 0;
    s_lastFrameTime = 0;

    resetTextAnimation(now);
}


// ------------------------------------------------------------
// Idle mit Text beginnen → Text zuerst (für Boot)
// ------------------------------------------------------------
void startIdleTextFirst(unsigned long now) {
    s_state         = IDLE_TEXT;
    s_frame         = 0;
    s_lastFrameTime = 0;

    resetTextAnimation(now);
}


// ------------------------------------------------------------
// Idle stoppen
// ------------------------------------------------------------
void stop() {
    s_state = IDLE_OFF;
}



// ------------------------------------------------------------
// Haupt-Statemachine
// ------------------------------------------------------------
void tickIdle(DisplayType &display, unsigned long now) {

    switch (s_state) {

        // --------------------------
        case IDLE_OFF:
            return;


        // --------------------------
        case IDLE_ANIM: {
            if (s_lastFrameTime == 0 || (now - s_lastFrameTime) >= IDLE_ANIM_FRAME_DELAY) {

                drawFrameCropped(display, s_frame);

                s_lastFrameTime = now;
                s_frame++;

                if (s_frame >= FRAME_COUNT) {
                    s_state = IDLE_TEXT;
                    resetTextAnimation(now);
                }
            }
        } break;


        // --------------------------
        case IDLE_TEXT: {

            // ===== Tipp-Animation (Buchstabe für Buchstabe) =====
            if (s_textCharIndex < s_textLen) {

                if (s_lastCharTime == 0) {
                    // erster Buchstabe
                    s_textCharIndex = 1;
                    s_lastCharTime  = now;
                    drawIdleText(display, s_textCharIndex, false);
                }
                else if ((now - s_lastCharTime) >= IDLE_TEXT_CHAR_DELAY) {
                    // nächster Buchstabe
                    s_textCharIndex++;
                    s_lastCharTime = now;
                    drawIdleText(display, s_textCharIndex, false);
                }

                // Layout wird erst gebraucht, wenn Text fertig ist
            }

            // ===== Cursor-Blinken, nachdem der Text komplett ist =====
            else {
                // Einmal Layout berechnen (Position von Text & Cursor)
                if (!s_layoutReady) {
                    computeLayout(display);
                    s_cursorVisible   = false;
                    s_lastCursorBlink = now;
                    // Text steht bereits vom letzten drawIdleText()
                }

                if ((now - s_lastCursorBlink) >= IDLE_TEXT_CURSOR_BLINK_INTERVAL) {
                    s_cursorVisible   = !s_cursorVisible;
                    s_lastCursorBlink = now;
                    drawCursor(display, s_cursorVisible);
                }
            }

            // ===== Gesamtdauer abgelaufen? → zurück zur Animation =====
            if ((now - s_textStartTime) >= IDLE_TEXT_DURATION) {
                s_state         = IDLE_ANIM;
                s_frame         = 0;
                s_lastFrameTime = 0;
            }

        } break;

    }
}

} // namespace DisplayAnim
